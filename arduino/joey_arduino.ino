#include <AM2320.h>

#include <Arduino.h>
#include <U8g2lib.h>

#ifdef U8X8_HAVE_HW_SPI
#include <SPI.h>
#endif
#ifdef U8X8_HAVE_HW_I2C
#include <Wire.h>
#endif

AM2320 th(&Wire);

const int BUTTON1 = 2;
const int BUTTON2 = 3;
const int BUTTON3 = 4;
const int BUTTON4 = 5;

char object = ' ';
String data;


char receivedData[] = " ";
String stringData = receivedData;
int rc;
bool recvInProgress = false;
String buddyData = "";
String buddyName = "Standard";
String buddySkin = "Standard";
int userTemp = 22;
int cycle = 0;
String userPlanning = "";
int userHum = 3;

// 'Snorlax', 48x48px
static const unsigned char mySnorlaxBig [] PROGMEM = {
   0x00, 0x00, 0x00, 0x00, 0x00, 0x00, 0x00, 0x00, 0x00, 0x00, 0x00, 0x00,
   0x00, 0x00, 0x00, 0x00, 0x00, 0x00, 0x00, 0x00, 0x00, 0x00, 0x00, 0x00,
   0x00, 0x00, 0x00, 0x60, 0x00, 0x00, 0x00, 0x00, 0x04, 0xf0, 0x00, 0x00,
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   0x00, 0x00, 0x00, 0x00, 0x00, 0x00, 0x00, 0x00, 0x00, 0x00, 0x00, 0x00
};

static const unsigned char myTurtleBig [] PROGMEM = {
  0x00, 0x00, 0x00, 0x00, 0x00, 0x00, 0x00, 0x00, 0x00, 0x00, 0x00, 0x00,
   0x00, 0x00, 0x00, 0x00, 0x00, 0x00, 0x00, 0x00, 0x00, 0x00, 0x00, 0x00,
   0x00, 0x00, 0x00, 0x00, 0x00, 0x00, 0x00, 0x00, 0x00, 0x00, 0x00, 0x00,
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   0x00, 0x00, 0x00, 0x00, 0x00, 0x00, 0x00, 0x00, 0x00, 0x00, 0x00, 0x00
};

static const unsigned char myTurtleSmall [] PROGMEM = {
  0x00, 0x00, 0x00, 0x00, 0x00, 0x00, 0x00, 0x00, 0x00, 0x00, 0x00, 0x00,
   0x00, 0x00, 0x00, 0x00, 0x00, 0x00, 0x00, 0x00, 0x00, 0xfc, 0x0f, 0x00,
   0x00, 0x07, 0x38, 0x00, 0x80, 0x87, 0x71, 0x00, 0xc0, 0xc6, 0xb8, 0x00,
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   0x00, 0x00, 0x00, 0x00, 0x00, 0x00, 0x00, 0x00
};

static const unsigned char myCharizardBig [] PROGMEM = {
  0x00, 0x00, 0x00, 0x00, 0x00, 0x00, 0x00, 0x00, 0x00, 0x00, 0x00, 0x00,
   0x00, 0x00, 0x00, 0x00, 0x00, 0x00, 0x00, 0x00, 0x00, 0x00, 0x00, 0x00,
   0x00, 0x00, 0x00, 0x00, 0x00, 0x00, 0x00, 0x00, 0x00, 0x04, 0x01, 0x00,
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   0x00, 0x00, 0x00, 0xc0, 0x1f, 0x00, 0x00, 0x00, 0x00, 0x80, 0x0d, 0x00
};

static const unsigned char myCharizardSmall [] PROGMEM = {
  0x00, 0x00, 0x00, 0x00, 0x00, 0x00, 0x00, 0x00, 0x00, 0x00, 0x00, 0x00,
   0x00, 0x00, 0x00, 0x00, 0x00, 0x02, 0x00, 0x00, 0x00, 0x00, 0xf0, 0x01,
   0xf0, 0x00, 0xf8, 0x07, 0xf8, 0x00, 0xf8, 0x07, 0xfc, 0x01, 0xf8, 0x0f,
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   0x80, 0x07, 0x70, 0x01, 0x00, 0x00, 0xe0, 0x00
};

static const unsigned char myLionBig [] PROGMEM = {
  0x00, 0x00, 0x00, 0x00, 0x00, 0x00, 0x00, 0x00, 0x00, 0x00, 0x00, 0x00,
   0x00, 0x00, 0x00, 0x00, 0x00, 0x00, 0x00, 0x00, 0x00, 0x20, 0x00, 0x00,
   0x00, 0x00, 0x00, 0xf8, 0x00, 0x00, 0x00, 0x00, 0xc0, 0xad, 0x39, 0x00,
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   0x00, 0x00, 0x00, 0x00, 0x00, 0x00, 0x00, 0x00, 0x00, 0x00, 0x00, 0x00
};

// 'Snorlax', 32x32px
static const unsigned char mySnorlaxSmall [] PROGMEM = {
   0x00, 0x00, 0x00, 0x00, 0x00, 0x00, 0x00, 0x00, 0x00, 0x00, 0x00, 0x00,
   0x00, 0x00, 0x18, 0x00, 0x00, 0x38, 0x36, 0x00, 0x00, 0xe8, 0x3f, 0x00,
   0x00, 0x18, 0x78, 0x00, 0x00, 0x48, 0x70, 0x00, 0x00, 0x00, 0x70, 0x00,
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   0x00, 0x00, 0x00, 0x00, 0x00, 0x00, 0x00, 0x00
};

// 'Leeuwtje', 32x32px
static const unsigned char myLionSmall [] PROGMEM = {
   0x00, 0x00, 0x00, 0x00, 0x00, 0x00, 0x00, 0x00, 0x00, 0x00, 0x18, 0x00,
   0x00, 0x80, 0x3e, 0x01, 0x1c, 0xe0, 0xe3, 0x03, 0x36, 0x60, 0x09, 0x06,
   0x26, 0x30, 0x80, 0x04, 0x2a, 0x3c, 0x00, 0x1c, 0x34, 0x04, 0x00, 0x30,
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   0x00, 0x00, 0x00, 0x00, 0x00, 0x00, 0x00, 0x00
};


static const unsigned char myLadybugBig [] PROGMEM = {
   0x00, 0x00, 0x00, 0x00, 0x00, 0x00, 0x00, 0x00, 0x3e, 0x00, 0x00, 0x00,
   0x00, 0x00, 0x7f, 0x00, 0x00, 0x00, 0x00, 0x00, 0x7f, 0x00, 0x00, 0x00,
   0x00, 0x00, 0x7f, 0x00, 0x00, 0x00, 0xe0, 0x00, 0x7f, 0x80, 0x03, 0x00,
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   0x00, 0x00, 0x3e, 0x00, 0x00, 0x00, 0x00, 0x00, 0x00, 0x00, 0x00, 0x00 
};

static const unsigned char myLadybugSmall [] PROGMEM = {
   0x00, 0x00, 0x00, 0x00, 0x00, 0x78, 0x00, 0x00, 0x00, 0x78, 0x00, 0x00,
   0x00, 0x78, 0x00, 0x00, 0x78, 0xfc, 0x78, 0x00, 0xfc, 0xff, 0xff, 0x00,
   0xfc, 0x01, 0xfe, 0x00, 0x78, 0x00, 0xfc, 0x00, 0x38, 0x00, 0xf0, 0x01,
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   0x00, 0x78, 0x00, 0x00, 0x00, 0x00, 0x00, 0x00 
};

U8G2_ST7920_128X64_1_SW_SPI u8g2(U8G2_R0, /* clock=*/ 11, /* data=*/ 10, /* CS=*/ 9, /* reset=*/ 8);

int drawstate = 0;
int screenstate = 0;
 
void prepare(void){
  u8g2.setFont(u8g2_font_5x7_tf);
  u8g2.setFontRefHeightExtendedText();
  u8g2.setDrawColor(1);
  u8g2.setFontPosTop();
  u8g2.setFontDirection(0);
}

void drawStart(void)
{
  if(buddySkin == "Snorlax"){
    u8g2.drawXBMP(0, 0, 48, 48, mySnorlaxBig);
  }
  else if(buddySkin == "Lion"){
    u8g2.drawXBMP(0, 0, 48, 48, myLionBig);
  }
  else if(buddySkin == "Ladybug"){
    u8g2.drawXBMP(0, 0, 48, 48, myLadybugBig);
  }
  else if(buddySkin == "Turtle"){
        u8g2.drawXBMP(0, 0, 48, 48, myTurtleBig);
  }
  else if(buddySkin == "Charizard"){
        u8g2.drawXBMP(0, 0, 48, 48, myCharizardBig);
  }
  u8g2.drawStr(56, 6, "1. Planning");
  u8g2.drawStr(56, 22, "2. Temperatuur");
  u8g2.drawStr(56, 38, "3. Humidity");
  u8g2.drawStr(56, 54, "4. Licht");
  u8g2.setCursor(4, 48);
  u8g2.print(buddyName);
}

void drawWeerbericht(void){
  if(buddySkin == "Snorlax"){
        u8g2.drawXBMP(0, 0, 32, 32, mySnorlaxSmall);
      }
  else if(buddySkin == "Lion"){
    u8g2.drawXBMP(0, 0, 32, 32, myLionSmall);
  }
  else if(buddySkin == "Ladybug"){
        u8g2.drawXBMP(0, 0, 32, 32, myLadybugSmall);
  }
  else if(buddySkin == "Turtle"){
        u8g2.drawXBMP(0, 0, 32, 32, myTurtleSmall);
  }
  else if(buddySkin == "Charizard"){
        u8g2.drawXBMP(0, 0, 32, 32, myCharizardSmall);
  }
  u8g2.drawFrame(0,32,u8g2.getDisplayWidth(),32 );
  
  
  char planningChars[userPlanning.length()];
  userPlanning.toCharArray(planningChars, userPlanning.length());
  if(sizeof(planningChars) > 0 && sizeof(planningChars) <= 18){
    u8g2.drawStr(2, 34, "Nog maar 3 uur tot bedtijd,");
    u8g2.drawStr(2, 42, "ga nog even lekker studeren.");
  }
  else if(sizeof(planningChars) > 18 && sizeof(planningChars) <=36){
    for(int i=0; i<sizeof(planningChars); i++){      
      if(planningChars[i] == 'P'){
        String pauzes = userPlanning.substring(i-5, i);
        u8g2.setCursor(2,34);
        u8g2.print("Neem pauze om: " + pauzes + " uur.");
        u8g2.setCursor(2, 42);
        u8g2.print("Dan is het beste weer om");
        u8g2.setCursor(2, 50);
        u8g2.print("naar buiten te gaan.");
      }
    }
  }  
  else if(sizeof(planningChars) > 36 && sizeof(planningChars) <=54){
      String pauzes[2];
      int gevonden = 0;
      for(int i=0; i<sizeof(planningChars); i++){      
        if(planningChars[i] == 'P' && gevonden == 0){
          pauzes[0] = userPlanning.substring(i-5, i);
          gevonden++;
        }
        else if(planningChars[i] == 'P' && gevonden == 1){
          pauzes[1] = userPlanning.substring(i-5, i);
        }
      }
      u8g2.setCursor(2,34);
      u8g2.print("Neem pauze om: " + pauzes[0] + " uur");
      u8g2.setCursor(2, 42);
      u8g2.print("en om: " + pauzes[1] + " uur");
      u8g2.setCursor(2, 50);
      u8g2.print("Om naar buiten te gaan.");
  }
  else if(sizeof(planningChars) > 54 ){
    String pauzes[3];
    int gevonden = 0;
    for(int i=0; i<sizeof(planningChars); i++){      
      if(planningChars[i] == 'P' && gevonden == 0){
        pauzes[0] = userPlanning.substring(i-5, i);
        gevonden++;
      }
      else if(planningChars[i] == 'P' && gevonden == 1){
        pauzes[1] = userPlanning.substring(i-5, i);
        gevonden++;
      }
      else if(planningChars[i] == 'P' && gevonden == 2){
        pauzes[2] = userPlanning.substring(i-5, i);
      }
    }
    u8g2.setCursor(2,34);
    u8g2.print("Neem pauze om: " + pauzes[0] + ", ");
    u8g2.setCursor(2, 42);
    u8g2.print(pauzes[1] + ", " + pauzes[2]);
    u8g2.setCursor(2, 50);
    u8g2.print("Om naar buiten te gaan");
  }
  u8g2.drawStr(76, 2, "1. Terug");
}



void drawTemp(void){
  if(cycle == 0){
    th.Read();
  }
   int currTemp = th.cTemp;
   
   if(currTemp > userTemp){
     u8g2.drawStr(2, 34, "Het is net wat warmer");
     u8g2.drawStr(2, 42, "dan je lekker vind!");
   }
   else if(currTemp < userTemp){
     u8g2.drawStr(2, 34, "Het is net wat kouder");
     u8g2.drawStr(2, 42, "dan je lekker vind!");
   }
   else if(currTemp == userTemp){
     u8g2.drawStr(2, 34, "De temperatuur is precies");
     u8g2.drawStr(2, 42, "goed!");
   }
   cycle = 1;

  if(buddySkin == "Snorlax"){
        u8g2.drawXBMP(0, 0, 32, 32, mySnorlaxSmall);
  }
  else if(buddySkin == "Lion"){
        u8g2.drawXBMP(0, 0, 32, 32, myLionSmall);
  }
  else if(buddySkin == "Ladybug"){
        u8g2.drawXBMP(0, 0, 32, 32, myLadybugSmall);
  }
  else if(buddySkin == "Turtle"){
        u8g2.drawXBMP(0, 0, 32, 32, myTurtleSmall);
  }
  else if(buddySkin == "Charizard"){
        u8g2.drawXBMP(0, 0, 32, 32, myCharizardSmall);
  }
  
  u8g2.drawFrame(0,32,u8g2.getDisplayWidth(),32 );
  u8g2.drawStr(76, 2, "1. Terug");
}

void drawVocht(void){
  if(buddySkin == "Snorlax"){
        u8g2.drawXBMP(0, 0, 32, 32, mySnorlaxSmall);
  }
  else if(buddySkin == "Lion"){
    u8g2.drawXBMP(0, 0, 32, 32, myLionSmall);
  }
  else if(buddySkin == "Ladybug"){
    u8g2.drawXBMP(0, 0, 32, 32, myLadybugSmall);
  }
  else if(buddySkin == "Turtle"){
        u8g2.drawXBMP(0, 0, 32, 32, myTurtleSmall);
  }
  else if(buddySkin == "Charizard"){
        u8g2.drawXBMP(0, 0, 32, 32, myCharizardSmall);
  }

  u8g2.drawFrame(0,32,u8g2.getDisplayWidth(),32 );
  u8g2.drawStr(76, 2, "1. Terug");

  if(cycle == 0){
    th.Read();
  }
  int currHum = th.Humidity;
  if(currHum > userHum){
    u8g2.drawStr(2, 34, "De luchtvochtigheid");
    u8g2.drawStr(2, 42, "is te hoog");
  }
  else if(currHum < userHum){
    u8g2.drawStr(2, 34, "De luchtvochtigheid");
    u8g2.drawStr(2, 42, "is te laag!");
  }
  else if(currHum == userHum){
    u8g2.drawStr(2, 34, "De luchtvochtigheid");
    u8g2.drawStr(2, 42, "is precies goed!");
  }
   cycle = 1;
}

void drawLicht(void){
  int lightvalue = analogRead(A0);
  if(buddySkin == "Snorlax"){
    u8g2.drawXBMP(0, 0, 32, 32, mySnorlaxSmall);
  }
  else if(buddySkin == "Lion"){
    u8g2.drawXBMP(0, 0, 32, 32, myLionSmall);
  }
  else if(buddySkin == "Ladybug"){
    u8g2.drawXBMP(0, 0, 32, 32, myLadybugSmall);
  }
  else if(buddySkin == "Turtle"){
        u8g2.drawXBMP(0, 0, 32, 32, myTurtleSmall);
  }
  else if(buddySkin == "Charizard"){
        u8g2.drawXBMP(0, 0, 32, 32, myCharizardSmall);
  }
  u8g2.drawFrame(0,32,u8g2.getDisplayWidth(),32 );

  if(lightvalue < 20){
    u8g2.drawStr(2, 34, "Zet een lamp aan!");
    u8g2.drawStr(2, 42, "Het is te donker");
  }
  else if(lightvalue >= 20 && lightvalue < 30){
    u8g2.drawStr(2, 34, "Zet een lamp aan!");
    u8g2.drawStr(2, 42, "Het is iets te donker");
  }
  else if(lightvalue >= 30){
    u8g2.drawStr(2, 34, "Het licht is prima!");
  }
  u8g2.drawStr(76, 2, "1. Terug");
}




void draw(){
  prepare();
  switch(drawstate) {
    case 0: drawStart(); break;
    case 1: drawWeerbericht(); break;
    case 2: drawTemp(); break;
    case 3: drawVocht(); break;
    case 4: drawLicht(); break;
    
  }
}




void setup() 
{
  Serial.begin(9600);
  pinMode(BUTTON1, INPUT_PULLUP);
  pinMode(BUTTON2, INPUT_PULLUP);
  pinMode(BUTTON3, INPUT_PULLUP);
  pinMode(BUTTON4, INPUT_PULLUP);
  
  
  u8g2.begin();
  u8g2.clearBuffer();
  Wire.begin();
}





int stepper = 0;
void loop()
{
  while(Serial.available() > 0){
    if(stepper == 0){
      String opvangtest = Serial.readStringUntil('\n');
      stepper++;
    }
    else if(stepper == 1){
      buddyName = Serial.readStringUntil('\n');
      stepper++;
    }
    else if(stepper == 2){
      buddySkin = Serial.readStringUntil('\n');
      stepper++;
    }
    else if(stepper == 3){
      userTemp = Serial.readStringUntil('\n').toInt();
      stepper++;
    }
    else if(stepper == 4){
      userHum = Serial.readStringUntil('\n').toInt();
      stepper++;
    }
    else if(stepper == 5){
      userPlanning = Serial.readStringUntil('\n');
      stepper = 0;
    }
    
  }

  

  
  
  if(digitalRead(BUTTON1) == LOW){
    if(screenstate == 1){
      drawstate = 0;
      screenstate = 0;
    }
    else{
      drawstate = 1;
      screenstate = 1;
      Serial.println('b');
    }
  }
  else if(digitalRead(BUTTON2) == LOW){
    drawstate = 2;
    screenstate = 1;
    cycle = 0;
  }
  else if(digitalRead(BUTTON3) == LOW){
    drawstate = 3;
    screenstate = 1;
    
  }
  else if(digitalRead(BUTTON4) == LOW){
    drawstate = 4;
    screenstate = 1;
    
  }
  
  u8g2.firstPage();
  do
  {
    draw();
    
    
  }while(u8g2.nextPage());

  delay(1000);

}
